## arch/riscv/cpu/wh/Kconfig
```kconfig
config RISCV_NDS
	bool
	select ARCH_EARLY_INIT_R
	imply CPU
	imply CPU_RISCV
	imply RISCV_TIMER
	help
	  Run U-Boot on AndeStar V5 platforms and use some specific features
	  which are provided by Andes Technology AndeStar V5 families.

if RISCV_NDS

config RISCV_NDS_CACHE
	bool "UC TECH IP 5 families specific cache support"
	depends on RISCV_MMODE
	help
	  Provide UC TECH IP V5 families specific cache support.

endif
```

## board/uctechip/wh-lsextend/Kconfig
```kconfig
if TARGET_WH_LSEXTEND

config SYS_CPU
	default "wh"

config SYS_BOARD
	default "wh-lsextend"

config SYS_VENDOR
	default "uctechip"

config SYS_SOC
	default "lsextend"

config SYS_CONFIG_NAME
	default "wh-lsextend"

endif
```

## configs/perf_defconfig
```kconfig
CONFIG_RISCV=y
CONFIG_SYS_TEXT_BASE=0x40000000
CONFIG_TARGET_WH_LSEXTEND=y
CONFIG_DISTRO_DEFAULTS=y
CONFIG_NR_DRAM_BANKS=2
CONFIG_FIT=y
CONFIG_BOOTDELAY=6
CONFIG_BOOTCOMMAND="mmcinfo;echo 'Start fatload linux kernel and dtb...';fatload mmc 0:1 0x41000000 /bbl.bin;fatload mmc 0:1 0x42000000 /wh-lsextend.dtb;go 0x41000000 0x0 0x42000000"
CONFIG_SYS_PROMPT="RISC-V # "
CONFIG_CMD_IMLS=y
CONFIG_CMD_MMC=y
CONFIG_CMD_SF=y
CONFIG_CMD_SF_TEST=y
# CONFIG_CMD_SETEXPR is not set
CONFIG_BOOTP_PREFER_SERVERIP=y
CONFIG_CMD_CACHE=y
CONFIG_OF_LIVE=y
CONFIG_OF_EMBED=y
CONFIG_DEFAULT_DEVICE_TREE="wh-lsextend"
CONFIG_NET_RANDOM_ETHADDR=y
CONFIG_MMC=y
CONFIG_WH_MMC=y
CONFIG_FLASH_CFI_DRIVER=y
CONFIG_CFI_FLASH=y
CONFIG_SYS_FLASH_USE_BUFFER_WRITE=y
CONFIG_SYS_FLASH_CFI=y
CONFIG_SPI_FLASH=y
CONFIG_SF_DEFAULT_MODE=0x0
CONFIG_SPI_FLASH_MACRONIX=y
CONFIG_PHYLIB=y
CONFIG_PHY_ADDR_ENABLE=y
CONFIG_PHY_ADDR=1
# CONFIG_DM_ETH is not set
CONFIG_ETHOC=y
CONFIG_WH_SERIAL=y
CONFIG_SPI=y
# CONFIG_TIMER is not set
```

## configs/wh-lsextend_defconfig
```kconfig
CONFIG_RISCV=y
CONFIG_SYS_TEXT_BASE=0x40000000
CONFIG_TARGET_WH_LSEXTEND=y
CONFIG_DISTRO_DEFAULTS=y
CONFIG_NR_DRAM_BANKS=2
CONFIG_FIT=y
CONFIG_BOOTDELAY=6
#CONFIG_BOARD_EARLY_INIT_F=y
CONFIG_SYS_PROMPT="RISC-V # "
CONFIG_CMD_IMLS=y
CONFIG_CMD_MMC=y
CONFIG_CMD_SF=y
CONFIG_CMD_SF_TEST=y
# CONFIG_CMD_SETEXPR is not set
CONFIG_BOOTP_PREFER_SERVERIP=y
CONFIG_CMD_CACHE=y
CONFIG_OF_LIVE=y
CONFIG_OF_EMBED=y
CONFIG_DEFAULT_DEVICE_TREE="wh-lsextend"
#CONFIG_ENV_IS_IN_SPI_FLASH=y
CONFIG_NET_RANDOM_ETHADDR=y
CONFIG_MMC=y
#CONFIG_FTSDC010=y
#CONFIG_FTSDC010_SDIO=y
#CONFIG_MTD_NOR_FLASH=y
CONFIG_FLASH_CFI_DRIVER=y
CONFIG_CFI_FLASH=y
CONFIG_SYS_FLASH_USE_BUFFER_WRITE=y
CONFIG_SYS_FLASH_CFI=y
CONFIG_SPI_FLASH=y
CONFIG_SF_DEFAULT_MODE=0x0
CONFIG_SPI_FLASH_MACRONIX=y
#CONFIG_FTMAC100=y
CONFIG_BAUDRATE=115200
#CONFIG_SYS_NS16550=y
CONFIG_SPI=y
#CONFIG_ATCSPI200_SPI=y
CONFIG_WH_SERIAL=y
CONFIG_TIMER=n
CONFIG_DM_ETH=n
CONFIG_PHYLIB=y
CONFIG_PHY_ADDR_ENABLE=y
CONFIG_PHY_ADDR=1
CONFIG_ETHOC=y
CONFIG_SYS_HZ=100
```
